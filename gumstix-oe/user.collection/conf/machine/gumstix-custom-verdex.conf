## gumstix-oe/user.collection/conf/machine/gumstix-custom-verdex.conf
```bitbake
#
# Use this file as a starting point for your custom gumstix configuration
# Edit it to reflect your hardware setup and then save it a parallel location in user.collection

MACHINE_FEATURES += "verdex"
MACHINE_FEATURES += "iwmmxt"
require conf/machine/include/gumstix.inc
require conf/machine/include/tune-xscale.inc

#
# Your flash size = Total flash (in MB) - 1 (for linux kernel partition)
ROOT_FLASH_SIZE = "15"
#ROOT_FLASH_SIZE = "31"

#
# Enable use of virtual terminal for LCD on tty1 if USE_VT = "1"
#USE_VT = "0"
USE_VT = "1"
SYSVINIT_ENABLED_GETTYS = "1"

#
# Uncomment features that your board set supports

MACHINE_FEATURES += "usbhost"
#MACHINE_FEATURES += "usbgadget"

MACHINE_FEATURES  += "i2c"
#MACHINE_FEATURES  += "spi"

MACHINE_FEATURES  += "serial"
#MACHINE_FEATURES  += "bluetooth"
MACHINE_FEATURES  += "sound"

# if you enable robostix you will need to disable both "lcd" and "touchscreen" features
#MACHINE_FEATURES  += "robostix"

#MACHINE_FEATURES  += "lcd"
MACHINE_FEATURES  += "rgb16"
#MACHINE_FEATURES  += "rgb18"

#MACHINE_FEATURES  += "touchscreen"
#MACHINE_FEATURES  += "keyboard"

MACHINE_FEATURES  += "pcmcia"
MACHINE_FEATURES  += "mmc"

MACHINE_FEATURES  += "wifi"
MACHINE_FEATURES  += "ethernet"

MACHINE_FEATURES  += "ext2"
MACHINE_FEATURES  += "fat"

# enable one of the following if you want to target build for uimage/rootfs on mmc/microSD or CF
#MACHINE_FEATURES  += "mmcroot"
#MACHINE_FEATURES  += "cfroot"

#
# note:  selection of MACHINE_FEATURES above will automatically include necessary kernel modules
# for those features via task-base-gumstix.  Include below any extra kernel modules that you want installed

#MACHINE_ESSENTIAL_EXTRA_RRECOMMENDS += "kernel-module-xxxxxxx"
MACHINE_ESSENTIAL_EXTRA_RRECOMMENDS += "kernel-module-ext3"

MACHINE_ESSENTIAL_EXTRA_RRECOMMENDS += "kernel-module-cpia2"
MACHINE_ESSENTIAL_EXTRA_RRECOMMENDS += "kernel-module-cx22700"
MACHINE_ESSENTIAL_EXTRA_RRECOMMENDS += "kernel-module-cx22702"
MACHINE_ESSENTIAL_EXTRA_RRECOMMENDS += "kernel-module-cx24110"
MACHINE_ESSENTIAL_EXTRA_RRECOMMENDS += "kernel-module-cx24123"
MACHINE_ESSENTIAL_EXTRA_RRECOMMENDS += "kernel-module-cypress-cy7c63"
MACHINE_ESSENTIAL_EXTRA_RRECOMMENDS += "kernel-module-cytherm"
MACHINE_ESSENTIAL_EXTRA_RRECOMMENDS += "kernel-module-dib0070"
MACHINE_ESSENTIAL_EXTRA_RRECOMMENDS += "kernel-module-dib3000mb"
MACHINE_ESSENTIAL_EXTRA_RRECOMMENDS += "kernel-module-dib3000mc"
MACHINE_ESSENTIAL_EXTRA_RRECOMMENDS += "kernel-module-dib7000m"
MACHINE_ESSENTIAL_EXTRA_RRECOMMENDS += "kernel-module-dib7000p"
MACHINE_ESSENTIAL_EXTRA_RRECOMMENDS += "kernel-module-dibx000-common"
MACHINE_ESSENTIAL_EXTRA_RRECOMMENDS += "kernel-module-dvb-core"
MACHINE_ESSENTIAL_EXTRA_RRECOMMENDS += "kernel-module-dvb-pll"
MACHINE_ESSENTIAL_EXTRA_RRECOMMENDS += "kernel-module-dvb-ttusb-budget"
MACHINE_ESSENTIAL_EXTRA_RRECOMMENDS += "kernel-module-dvb-usb"
MACHINE_ESSENTIAL_EXTRA_RRECOMMENDS += "kernel-module-dvb-usb-a800"
MACHINE_ESSENTIAL_EXTRA_RRECOMMENDS += "kernel-module-dvb-usb-af9005"
MACHINE_ESSENTIAL_EXTRA_RRECOMMENDS += "kernel-module-dvb-usb-af9005-remote"
MACHINE_ESSENTIAL_EXTRA_RRECOMMENDS += "kernel-module-dvb-usb-au6610"
MACHINE_ESSENTIAL_EXTRA_RRECOMMENDS += "kernel-module-dvb-usb-cxusb"
MACHINE_ESSENTIAL_EXTRA_RRECOMMENDS += "kernel-module-dvb-usb-dib0700"
MACHINE_ESSENTIAL_EXTRA_RRECOMMENDS += "kernel-module-dvb-usb-dibusb-common"
MACHINE_ESSENTIAL_EXTRA_RRECOMMENDS += "kernel-module-dvb-usb-dibusb-mb"
MACHINE_ESSENTIAL_EXTRA_RRECOMMENDS += "kernel-module-dvb-usb-dibusb-mc"
MACHINE_ESSENTIAL_EXTRA_RRECOMMENDS += "kernel-module-dvb-usb-digitv"
MACHINE_ESSENTIAL_EXTRA_RRECOMMENDS += "kernel-module-dvb-usb-dtt200u"
MACHINE_ESSENTIAL_EXTRA_RRECOMMENDS += "kernel-module-dvb-usb-gl861"
MACHINE_ESSENTIAL_EXTRA_RRECOMMENDS += "kernel-module-dvb-usb-gp8psk"
MACHINE_ESSENTIAL_EXTRA_RRECOMMENDS += "kernel-module-dvb-usb-m920x"
MACHINE_ESSENTIAL_EXTRA_RRECOMMENDS += "kernel-module-dvb-usb-nova-t-usb2"
MACHINE_ESSENTIAL_EXTRA_RRECOMMENDS += "kernel-module-dvb-usb-opera"
MACHINE_ESSENTIAL_EXTRA_RRECOMMENDS += "kernel-module-dvb-usb-ttusb2"
MACHINE_ESSENTIAL_EXTRA_RRECOMMENDS += "kernel-module-dvb-usb-umt-010"
MACHINE_ESSENTIAL_EXTRA_RRECOMMENDS += "kernel-module-dvb-usb-vp702x"
MACHINE_ESSENTIAL_EXTRA_RRECOMMENDS += "kernel-module-dvb-usb-vp7045"
MACHINE_ESSENTIAL_EXTRA_RRECOMMENDS += "kernel-module-em28xx"
MACHINE_ESSENTIAL_EXTRA_RRECOMMENDS += "kernel-module-emi26"
MACHINE_ESSENTIAL_EXTRA_RRECOMMENDS += "kernel-module-emi62"
MACHINE_ESSENTIAL_EXTRA_RRECOMMENDS += "kernel-module-et61x251"
MACHINE_ESSENTIAL_EXTRA_RRECOMMENDS += "kernel-module-ftdi-elan"
MACHINE_ESSENTIAL_EXTRA_RRECOMMENDS += "kernel-module-ibmcam"
MACHINE_ESSENTIAL_EXTRA_RRECOMMENDS += "kernel-module-idmouse"
MACHINE_ESSENTIAL_EXTRA_RRECOMMENDS += "kernel-module-iowarrior"
MACHINE_ESSENTIAL_EXTRA_RRECOMMENDS += "kernel-module-ir-common"
MACHINE_ESSENTIAL_EXTRA_RRECOMMENDS += "kernel-module-ir-kbd-i2c"
MACHINE_ESSENTIAL_EXTRA_RRECOMMENDS += "kernel-module-isl6421"
MACHINE_ESSENTIAL_EXTRA_RRECOMMENDS += "kernel-module-isp116x-hcd"
MACHINE_ESSENTIAL_EXTRA_RRECOMMENDS += "kernel-module-konicawc"
MACHINE_ESSENTIAL_EXTRA_RRECOMMENDS += "kernel-module-l64781"
MACHINE_ESSENTIAL_EXTRA_RRECOMMENDS += "kernel-module-lcd"
MACHINE_ESSENTIAL_EXTRA_RRECOMMENDS += "kernel-module-ldusb"
MACHINE_ESSENTIAL_EXTRA_RRECOMMENDS += "kernel-module-legousbtower"
MACHINE_ESSENTIAL_EXTRA_RRECOMMENDS += "kernel-module-lgdt330x"
MACHINE_ESSENTIAL_EXTRA_RRECOMMENDS += "kernel-module-libusual"
MACHINE_ESSENTIAL_EXTRA_RRECOMMENDS += "kernel-module-lnbp21"
MACHINE_ESSENTIAL_EXTRA_RRECOMMENDS += "kernel-module-mdc800"
MACHINE_ESSENTIAL_EXTRA_RRECOMMENDS += "kernel-module-microtek"
MACHINE_ESSENTIAL_EXTRA_RRECOMMENDS += "kernel-module-mt2060"
MACHINE_ESSENTIAL_EXTRA_RRECOMMENDS += "kernel-module-mt20xx"
MACHINE_ESSENTIAL_EXTRA_RRECOMMENDS += "kernel-module-mt2131"
MACHINE_ESSENTIAL_EXTRA_RRECOMMENDS += "kernel-module-mt2266"
MACHINE_ESSENTIAL_EXTRA_RRECOMMENDS += "kernel-module-mt312"
MACHINE_ESSENTIAL_EXTRA_RRECOMMENDS += "kernel-module-mt352"
MACHINE_ESSENTIAL_EXTRA_RRECOMMENDS += "kernel-module-nxt200x"
MACHINE_ESSENTIAL_EXTRA_RRECOMMENDS += "kernel-module-nxt6000"
MACHINE_ESSENTIAL_EXTRA_RRECOMMENDS += "kernel-module-or51132"
MACHINE_ESSENTIAL_EXTRA_RRECOMMENDS += "kernel-module-or51211"
MACHINE_ESSENTIAL_EXTRA_RRECOMMENDS += "kernel-module-ov511"
MACHINE_ESSENTIAL_EXTRA_RRECOMMENDS += "kernel-module-ovcamchip"
MACHINE_ESSENTIAL_EXTRA_RRECOMMENDS += "kernel-module-phidget"
MACHINE_ESSENTIAL_EXTRA_RRECOMMENDS += "kernel-module-phidgetkit"
MACHINE_ESSENTIAL_EXTRA_RRECOMMENDS += "kernel-module-phidgetmotorcontrol"
MACHINE_ESSENTIAL_EXTRA_RRECOMMENDS += "kernel-module-phidgetservo"
MACHINE_ESSENTIAL_EXTRA_RRECOMMENDS += "kernel-module-qt1010"
MACHINE_ESSENTIAL_EXTRA_RRECOMMENDS += "kernel-module-quickcam-messenger"
MACHINE_ESSENTIAL_EXTRA_RRECOMMENDS += "kernel-module-r8a66597-hcd"
MACHINE_ESSENTIAL_EXTRA_RRECOMMENDS += "kernel-module-rio500"
MACHINE_ESSENTIAL_EXTRA_RRECOMMENDS += "kernel-module-s5h1409"
MACHINE_ESSENTIAL_EXTRA_RRECOMMENDS += "kernel-module-s5h1420"
MACHINE_ESSENTIAL_EXTRA_RRECOMMENDS += "kernel-module-saa7115"
MACHINE_ESSENTIAL_EXTRA_RRECOMMENDS += "kernel-module-se401"
MACHINE_ESSENTIAL_EXTRA_RRECOMMENDS += "kernel-module-sl811-cs"
MACHINE_ESSENTIAL_EXTRA_RRECOMMENDS += "kernel-module-sl811-hcd"
MACHINE_ESSENTIAL_EXTRA_RRECOMMENDS += "kernel-module-sn9c102"
MACHINE_ESSENTIAL_EXTRA_RRECOMMENDS += "kernel-module-sp8870"
MACHINE_ESSENTIAL_EXTRA_RRECOMMENDS += "kernel-module-sp887x"
MACHINE_ESSENTIAL_EXTRA_RRECOMMENDS += "kernel-module-stv0297"
MACHINE_ESSENTIAL_EXTRA_RRECOMMENDS += "kernel-module-stv0299"
MACHINE_ESSENTIAL_EXTRA_RRECOMMENDS += "kernel-module-stv680"
MACHINE_ESSENTIAL_EXTRA_RRECOMMENDS += "kernel-module-tda10021"
MACHINE_ESSENTIAL_EXTRA_RRECOMMENDS += "kernel-module-tda10023"
MACHINE_ESSENTIAL_EXTRA_RRECOMMENDS += "kernel-module-tda1004x"
MACHINE_ESSENTIAL_EXTRA_RRECOMMENDS += "kernel-module-tda10086"
MACHINE_ESSENTIAL_EXTRA_RRECOMMENDS += "kernel-module-tda8083"
MACHINE_ESSENTIAL_EXTRA_RRECOMMENDS += "kernel-module-tda826x"
MACHINE_ESSENTIAL_EXTRA_RRECOMMENDS += "kernel-module-tda827x"
MACHINE_ESSENTIAL_EXTRA_RRECOMMENDS += "kernel-module-tda8290"
MACHINE_ESSENTIAL_EXTRA_RRECOMMENDS += "kernel-module-tea5761"
MACHINE_ESSENTIAL_EXTRA_RRECOMMENDS += "kernel-module-tea5767"
MACHINE_ESSENTIAL_EXTRA_RRECOMMENDS += "kernel-module-trancevibrator"
MACHINE_ESSENTIAL_EXTRA_RRECOMMENDS += "kernel-module-ttusb-dec"
MACHINE_ESSENTIAL_EXTRA_RRECOMMENDS += "kernel-module-ttusbdecfe"
MACHINE_ESSENTIAL_EXTRA_RRECOMMENDS += "kernel-module-tua6100"
MACHINE_ESSENTIAL_EXTRA_RRECOMMENDS += "kernel-module-tuner"
MACHINE_ESSENTIAL_EXTRA_RRECOMMENDS += "kernel-module-tuner-simple"
MACHINE_ESSENTIAL_EXTRA_RRECOMMENDS += "kernel-module-tveeprom"
MACHINE_ESSENTIAL_EXTRA_RRECOMMENDS += "kernel-module-tvp5150"
MACHINE_ESSENTIAL_EXTRA_RRECOMMENDS += "kernel-module-ultracam"
MACHINE_ESSENTIAL_EXTRA_RRECOMMENDS += "kernel-module-usblcd"
MACHINE_ESSENTIAL_EXTRA_RRECOMMENDS += "kernel-module-usbled"
MACHINE_ESSENTIAL_EXTRA_RRECOMMENDS += "kernel-module-usbmon"
MACHINE_ESSENTIAL_EXTRA_RRECOMMENDS += "kernel-module-usbvideo"
MACHINE_ESSENTIAL_EXTRA_RRECOMMENDS += "kernel-module-usbvision"
MACHINE_ESSENTIAL_EXTRA_RRECOMMENDS += "kernel-module-ves1820"
MACHINE_ESSENTIAL_EXTRA_RRECOMMENDS += "kernel-module-ves1x93"
MACHINE_ESSENTIAL_EXTRA_RRECOMMENDS += "kernel-module-vicam"
MACHINE_ESSENTIAL_EXTRA_RRECOMMENDS += "kernel-module-videobuf-core"
MACHINE_ESSENTIAL_EXTRA_RRECOMMENDS += "kernel-module-videobuf-vmalloc"
MACHINE_ESSENTIAL_EXTRA_RRECOMMENDS += "kernel-module-vivi"
MACHINE_ESSENTIAL_EXTRA_RRECOMMENDS += "kernel-module-w9968cf"
MACHINE_ESSENTIAL_EXTRA_RRECOMMENDS += "kernel-module-zc0301"
MACHINE_ESSENTIAL_EXTRA_RRECOMMENDS += "kernel-module-zl10353"
MACHINE_ESSENTIAL_EXTRA_RRECOMMENDS += "kernel-module-zr364xx"

MACHINE_ESSENTIAL_EXTRA_RRECOMMENDS += "kernel-module-v4l1-compat"
MACHINE_ESSENTIAL_EXTRA_RRECOMMENDS += "kernel-module-v4l2-common"
MACHINE_ESSENTIAL_EXTRA_RRECOMMENDS += "kernel-module-v4l2-int-device"
#MACHINE_ESSENTIAL_EXTRA_RRECOMMENDS += "kernel-module-videobuf-dma-sg"
#MACHINE_ESSENTIAL_EXTRA_RRECOMMENDS += "kernel-module-videobuf-dvb"
MACHINE_ESSENTIAL_EXTRA_RRECOMMENDS += "kernel-module-videocodec"
MACHINE_ESSENTIAL_EXTRA_RRECOMMENDS += "kernel-module-videodev"

MACHINE_ESSENTIAL_EXTRA_RRECOMMENDS += "kernel-module-pwc"

#
# Uncomment or add kernel modules that should be autoloaded

module_autoload_proc_gpio      = 'proc_gpio'

module_autoload_pcmcia         = ${@base_contains('MACHINE_FEATURES', 'pcmcia',     'pcmcia', '',d)}
module_autoload_pxa2xx_cs      = ${@base_contains('MACHINE_FEATURES', 'pcmcia',     'pxa2xx_cs', '',d)}

module_autoload_pxamci         = ${@base_contains('MACHINE_FEATURES', 'mmc',        'pxamci', '',d)}
module_autoload_mmc_block      = ${@base_contains('MACHINE_FEATURES', 'mmc',        'mmc_block', '',d)}

module_autoload_ethernet       = ${@base_contains('MACHINE_FEATURES', 'ethernet',   'ethernet', '',d)}

module_autoload_ohci-hcd       = ${@base_contains('MACHINE_FEATURES', 'usbhost',    'ohci-hcd', '',d)}

#module_autoload_gumstix_gadget = ${@base_contains('MACHINE_FEATURES', 'usbgadget',  'gumstix_gadget', '',d)}
#module_autoload_g_file_storage = ${@base_contains('MACHINE_FEATURES', 'usbgadget',  'g_file_storage', '',d)}
#module_autoload_g_ether        = ${@base_contains('MACHINE_FEATURES', 'usbgadget',  'g_ether', '',d)}
#module_autoload_g_serial       = ${@base_contains('MACHINE_FEATURES', 'usbgadget',  'g_serial', '',d)}

#module_autoload_tsc2003        = ${@base_contains('MACHINE_FEATURES', 'touchscreen','tsc2003', '',d)}
#module_autoload_evdev          = ${@base_contains('MACHINE_FEATURES', 'touchscreen','evdev', '',d)}
```
